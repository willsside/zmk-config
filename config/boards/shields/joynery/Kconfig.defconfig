## config/boards/shields/joynery/Kconfig.defconfig
```kconfig
if SHIELD_JOYNERY_LEFT

config ZMK_KEYBOARD_NAME
	default "Joynery Left"

config ZMK_SPLIT_BLE_ROLE_CENTRAL
	default y

endif


if SHIELD_JOYNERY_RIGHT

config ZMK_KEYBOARD_NAME
	default "Joynery Right"

endif

if SHIELD_JOYNERY_LEFT || SHIELD_JOYNERY_RIGHT

config ZMK_SPLIT
	default y

endif
```

## config/boards/shields/joynery/Kconfig.shield
```kconfig
config SHIELD_JOYNERY_LEFT
	def_bool $(shields_list_contains,joynery_left)

config SHIELD_JOYNERY_RIGHT
	def_bool $(shields_list_contains,joynery_right)
```
